## knomi_firmware/sdkconfig.defaults
```kconfig
# ESP32-S3 target
CONFIG_IDF_TARGET="esp32s3"

# Flash / PSRAM
CONFIG_ESPTOOLPY_FLASHSIZE_16MB=y
CONFIG_SPIRAM=y
CONFIG_SPIRAM_MODE_OCT=y
CONFIG_SPIRAM_SPEED_80M=y

# WiFi — fill in before flashing
CONFIG_STUDY_RUNNER_WIFI_SSID="StudyNet"
CONFIG_STUDY_RUNNER_WIFI_PASSWORD=""
CONFIG_STUDY_RUNNER_PI_HOST="192.168.1.100"
CONFIG_STUDY_RUNNER_PI_PORT=3000

# Display (GC9A01 / ST7701 via SPI/QSPI — KNOMI 2 specific)
CONFIG_LV_COLOR_DEPTH_16=y

# FreeRTOS
CONFIG_FREERTOS_HZ=1000

# Log level
CONFIG_LOG_DEFAULT_LEVEL_INFO=y
```
